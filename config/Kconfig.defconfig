## config/Kconfig.defconfig
```kconfig
# Copyright (c) 2021 The ZMK Contributors
# SPDX-License-Identifier: MIT


if SHIELD_REDONGLE_DONGLE

config ZMK_KEYBOARD_NAME
    default "Redox"

config ZMK_SPLIT_BLE_ROLE_CENTRAL
    default y

config ZMK_USB
    default y

endif

if SHIELD_REDOX_LEFT || SHIELD_REDOX_RIGHT || SHIELD_REDOX_DONGLE

config ZMK_SPLIT
    default y

config ZMK_BLE
    default y

endif
```

## config/Kconfig.shield
```kconfig
# Copyright (c) 2021 The ZMK Contributors
# SPDX-License-Identifier: MIT

config SHIELD_REDONGLE_LEFT
    def_bool $(shields_list_contains,redongle_left)

config SHIELD_REDONGLE_RIGHT
    def_bool $(shields_list_contains,redongle_right)

config SHIELD_REDONGLE_DONGLE
	def_bool $(shields_list_contains,redongle_dongle)
```
